/dts-v1/;
/plugin/;
 
/{
    compatible = "ti,beaglebone", "ti,beaglebone-black", "ti,beaglebone-green";
    part-number = "BB-GIRTC";
    version = "00A0";

    fragment@0 {
        target = <&am33xx_pinmux>;
        __overlay__ {
            bb_i2cx_pins: pinmux_bb_i2cx_pins {
                pinctrl-single,pins = <
                    0x0cc  0x77 //  gpio2 17 0   P8.34
                    0x0dc  0x77 //  gpio0 11 0   P8.32
                >;
            };
        };
    };
/*
    fragment@1 {
		target-path="/";
		__overlay__ {

			aliases {
				rtc0 = "/i2c\@0/pcf8523@68";
				rtc1 = "/ocp/rtc@44e3e000";
			};
		};
    };
*/

    fragment@1 {
        target-path = "/";
        //target = <&ocp>;
        __overlay__ {
          i2c@0 {
	    compatible = "i2c-gpio";
            status = "okay";
            pinctrl-names = "default";
            pinctrl-0 = <&bb_i2cx_pins>;
            gpios = <
                     &gpio2 17 0 // sda 
		     &gpio0 11 0 // scl 
		    >;
	    //i2c-gpio,sda-open-drain;
	    //i2c-gpio,scl-open-drain;
	    i2c-gpio,delay-us = <20>;	// ~100 Hz
            i2c-gpio,timeout-ms = <100>;
	    #address-cells = <1>;
	    #size-cells = <0>;
/*
            pcf8523: pcf8523@68 {
              compatible = "nxp,pcf8523";
              reg = <0x68>;
            };
*/
          };
        };
   };
};
